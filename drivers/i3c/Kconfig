## drivers/i3c/Kconfig
```kconfig
# SPDX-License-Identifier: GPL-2.0

menuconfig I3C
	tristate "I3C support"
	select I2C
	help
	  I3C is a serial protocol standardized by the MIPI alliance.

	  It's supposed to be backward compatible with I2C while providing
	  support for high speed transfers and native interrupt support
	  without the need for extra pins.

	  The I3C protocol also standardizes the slave device types and is
	  mainly designed to communicate with sensors.

	  If you want I3C support, you should say Y here and also to the
	  specific driver for your bus adapter(s) below.

	  This I3C support can also be built as a module.  If so, the module
	  will be called i3c.

if I3C
source "drivers/i3c/master/Kconfig"
endif # I3C

config I3C_RENESAS_RG3MXXB12B0
	depends on I3C
	depends on I2C # todo: could be a sub-config for no-i2c cases
	select REGMAP_I3C
	tristate "Renesas RG3MxxB12B0 I3C hub device support"
	help
	  Renesata RG3MXXB12B0 I3C hub device driver.

	  Provides basic control of the hub, for i2c SMBus agent support
	  only, exposed as an i2c controller.
```

## drivers/net/mctp/Kconfig
```kconfig
if MCTP

menu "MCTP Device Drivers"

config MCTP_TRANSPORT_I2C
	tristate "MCTP SMBus/I2C transport"
	help
	  Provides a driver to access MCTP devices over SMBus/I2C transport,
	  from DMTF specification DSP0237. A MCTP protocol network device is
	  created for each I2C bus that has been assigned a mctp-i2c device.

endmenu

endif
```

## drivers/soc/microwatt/Kconfig
```kconfig
# SPDX-License-Identifier: GPL-2.0-only

if PPC_MICROWATT || COMPILE_TEST

menu "Microwatt SoC drivers"

config MICROWATT_LPC_CTRL
	tristate "Microwatt LPC firmware cycle control"
	default PPC_MICROWATT
	help
	  Control LPC firmware cycle mappings through ioctl()s. The driver
	  also provides a read/write interface to a BMC ram region where the
	  host LPC read/write region can be buffered.

endmenu

endif
```
